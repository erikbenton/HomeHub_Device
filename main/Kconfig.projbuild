## main/Kconfig.projbuild
```kconfig
menu "Wifi Connect Config"

config WIFI_SSID
    string "Enter wifi SSID to connect to"
    default "Wifi SSID not set"

config WIFI_PASSWORD
    string "Enter wifi password"
    default "no password"

endmenu

menu "Device Configuration"

config DEVICE_NAME
    string "Enter name for the device"
    default "Temperature Device"

config DEVICE_LOCATION
    string "Enter the location of the device"
    default "Office"

endmenu

menu "MQTT Connect Config"

config MQTT_BROKER_URI
    string "Enter URI of the MQTT broker to connect to"
    default "mqtt://test.mosquitto.org:1883"
        help
            this should include the port as well (eg: 1883)

config  MQTT_DEVICE_ID
    int "ID for device"
    range 0 9999
    default 1
        help
            this needs to be unique for each client device

endmenu
```
